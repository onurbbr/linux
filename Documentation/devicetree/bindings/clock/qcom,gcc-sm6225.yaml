## Documentation/devicetree/bindings/clock/qcom,gcc-sm6225.yaml
```yaml
# SPDX-License-Identifier: (GPL-2.0-only OR BSD-2-Clause)
%YAML 1.2
---
$id: http://devicetree.org/schemas/clock/qcom,gcc-sm6225.yaml#
$schema: http://devicetree.org/meta-schemas/core.yaml#

title: Qualcomm Global Clock & Reset Controller on SM6225

maintainers:
  - Onur BÜBER <onurbuber@engineer.com>

description: |
  Qualcomm global clock control module provides the clocks, resets and power
  domains on SM6225.

  See also: include/dt-bindings/clock/qcom,gcc-sm6225.h

properties:
  compatible:
    const: qcom,gcc-sm6225

  clocks:
    items:
      - description: Board XO source
      - description: Board XO A source
      - description: Sleep clock source

  clock-names:
    items:
      - const: bi_tcxo
      - const: bi_tcxo_ao
      - const: sleep_clk

required:
  - compatible
  - clocks
  - clock-names
  - '#power-domain-cells'

allOf:
  - $ref: qcom,gcc.yaml#

unevaluatedProperties: false

examples:
  - |
    #include <dt-bindings/clock/qcom,rpmcc.h>
    clock-controller@1400000 {
        compatible = "qcom,gcc-sm6225";
        reg = <0x01400000 0x1f0000>;
        #clock-cells = <1>;
        #reset-cells = <1>;
        #power-domain-cells = <1>;
        clock-names = "bi_tcxo", "bi_tcxo_ao", "sleep_clk";
        clocks = <&rpmcc RPM_SMD_XO_CLK_SRC>,
                 <&rpmcc RPM_SMD_XO_A_CLK_SRC>,
                 <&sleep_clk>;
    };
...
```

## Documentation/devicetree/bindings/clock/qcom,sm6225-dispcc.yaml
```yaml
# SPDX-License-Identifier: (GPL-2.0-only OR BSD-2-Clause)
%YAML 1.2
---
$id: http://devicetree.org/schemas/clock/qcom,sm6225-dispcc.yaml#
$schema: http://devicetree.org/meta-schemas/core.yaml#

title: Qualcomm Display Clock Controller for SM6225

maintainers:
  - Onur BÜBER <onurbuber@engineer.com>

description: |
  Qualcomm display clock control module provides the clocks, resets and power
  domains on SM6225.

  See also: include/dt-bindings/clock/qcom,dispcc-sm6225.h

properties:
  compatible:
    enum:
      - qcom,sm6225-dispcc

  clocks:
    items:
      - description: Board XO source
      - description: GPLL0 DISP DIV clock from GCC
      - description: Byte clock from DSI PHY0
      - description: Pixel clock from DSI PHY0

  power-domains:
    maxItems: 1

required:
  - compatible
  - clocks
  - '#power-domain-cells'

allOf:
  - $ref: qcom,gcc.yaml#

unevaluatedProperties: false

examples:
  - |
    #include <dt-bindings/clock/qcom,rpmcc.h>
    #include <dt-bindings/clock/qcom,gcc-sm6225.h>
    clock-controller@5f00000 {
      compatible = "qcom,sm6225-dispcc";
      reg = <0x5f00000 0x20000>;
      clocks = <&rpmcc RPM_SMD_XO_CLK_SRC>,
               <&gcc GCC_DISP_GPLL0_DIV_CLK_SRC>,
               <&dsi0_phy 0>,
               <&dsi0_phy 1>;
      #clock-cells = <1>;
      #reset-cells = <1>;
      #power-domain-cells = <1>;
    };
...
```

## Documentation/devicetree/bindings/display/panel/xiaomi,m7-38-0c-0a.yaml
```yaml
# SPDX-License-Identifier: (GPL-2.0-only OR BSD-2-Clause)
%YAML 1.2
---
$id: http://devicetree.org/schemas/display/panel/xiaomi,m7-38-0c-0a.yaml#
$schema: http://devicetree.org/meta-schemas/core.yaml#

title: Xiaomi "m7 38 0c 0a" 1080x2400 AMOLED MIPI-DSI panel

maintainers:
  - Onur BÜBER <onurbuber@engineer.com>

description: |
  The Xiaomi "m7 38 0c 0a" is a 1080x2400 AMOLED panel with a MIPI-DSI
  video mode interface and Display Stream Compression support, used in the
  Xiaomi Redmi Note 12 4G.

allOf:
  - $ref: panel-common.yaml#

properties:
  compatible:
    const: xiaomi,m7-38-0c-0a

  reg:
    maxItems: 1

  vddio-supply:
    description: 1.8V I/O supply rail

  enable-gpios:
    description: GPIO controlling the panel enable line
    maxItems: 1

  reset-gpios:
    maxItems: 1

  port: true

required:
  - compatible
  - reg
  - vddio-supply
  - enable-gpios
  - reset-gpios
  - port

additionalProperties: false

examples:
  - |
    #include <dt-bindings/gpio/gpio.h>

    dsi {
        #address-cells = <1>;
        #size-cells = <0>;

        panel@0 {
            compatible = "xiaomi,m7-38-0c-0a";
            reg = <0>;

            vddio-supply = <&vreg_l9>;
            enable-gpios = <&pm6125_gpios 9 GPIO_ACTIVE_HIGH>;
            reset-gpios = <&tlmm 82 GPIO_ACTIVE_HIGH>;

            port {
                panel_in: endpoint {
                    remote-endpoint = <&dsi0_out>;
                };
            };
        };
    };

...
```

## Documentation/devicetree/bindings/interconnect/qcom,sm6225.yaml
```yaml
# SPDX-License-Identifier: (GPL-2.0 OR BSD-2-Clause)
%YAML 1.2
---
$id: http://devicetree.org/schemas/interconnect/qcom,sm6225.yaml#
$schema: http://devicetree.org/meta-schemas/core.yaml#

title: Qualcomm SM6225 Network-On-Chip interconnect

maintainers:
  - Onur BÜBER <onurbuber@engineer.com>

description:
  The Qualcomm SM6225 interconnect providers support adjusting the
  bandwidth requirements between the various NoC fabrics.

properties:
  compatible:
    enum:
      - qcom,sm6225-bimc
      - qcom,sm6225-cnoc
      - qcom,sm6225-snoc

  reg:
    maxItems: 1

  clocks:
    minItems: 1
    maxItems: 4

  clock-names:
    minItems: 1
    maxItems: 4

# Child node's properties
patternProperties:
  '^interconnect-[a-z0-9]+$':
    type: object
    description:
      The interconnect providers do not have a separate QoS register space,
      but share parent's space.

    $ref: qcom,rpm-common.yaml#

    properties:
      compatible:
        enum:
          - qcom,sm6225-clk-virt
          - qcom,sm6225-mmrt-virt
          - qcom,sm6225-mmnrt-virt
          - qcom,sm6225-gpu-virt
          - qcom,sm6225-qup-virt

    required:
      - compatible

    unevaluatedProperties: false

required:
  - compatible
  - reg

allOf:
  - $ref: qcom,rpm-common.yaml#

unevaluatedProperties: false

examples:
  - |
    #include <dt-bindings/clock/qcom,gcc-sm6225.h>
    #include <dt-bindings/clock/qcom,rpmcc.h>
    system_noc: interconnect@1880000 {
        compatible = "qcom,sm6225-snoc";
        reg = <0x1880000 0x5f080>;
        clocks = <&gcc GCC_SYS_NOC_CPUSS_AHB_CLK>,
                 <&gcc GCC_SYS_NOC_UFS_PHY_AXI_CLK>,
                 <&gcc GCC_SYS_NOC_USB3_PRIM_AXI_CLK>,
                 <&rpmcc RPM_SMD_IPA_CLK>;
        clock-names = "cpu_axi", "ufs_axi", "usb_axi", "ipa";
        #interconnect-cells = <2>;

        clk_virt: interconnect-clk {
            compatible = "qcom,sm6225-clk-virt";
            #interconnect-cells = <2>;
        };

        mmrt_virt: interconnect-mmrt {
            compatible = "qcom,sm6225-mmrt-virt";
            #interconnect-cells = <2>;
        };

        mmnrt_virt: interconnect-mmnrt {
            compatible = "qcom,sm6225-mmnrt-virt";
            #interconnect-cells = <2>;
        };
    };
...
```

## Documentation/devicetree/bindings/leds/kinetic,ktd2691.yaml
```yaml
# SPDX-License-Identifier: (GPL-2.0-only OR BSD-2-Clause)
%YAML 1.2
---
$id: http://devicetree.org/schemas/leds/kinetic,ktd2691.yaml#
$schema: http://devicetree.org/meta-schemas/core.yaml#

title: KTD2691 Flash LED Driver from Kinetic Technologies

maintainers:
  - Onur BÜBER <onurbuber@engineer.com>

description: |
  KTD2691 is an inductorless, single flash LED driver with a programmable
  1.5 A current source. It is programmed over I2C and can drive up to 1.5 A
  in flash mode, up to 376 mA in torch mode, or an infrared LED in IR mode.

  The current source is shared between the three modes, so only the mode
  that is active at a given time draws current. Flash mode can be started
  either by writing the mode register or, if the STROBE pin is wired, by
  driving that pin high; the flash time-out then ends the pulse on its own.

properties:
  compatible:
    const: kinetic,ktd2691

  reg:
    maxItems: 1

  vin-supply:
    description: LED supply (2.7V to 5.5V).

  strobe-gpios:
    maxItems: 1
    description: |
      Specifier of the GPIO connected to the STROBE pin. When present the
      hardware strobe is used for the flash pulse instead of the mode
      register, and the pulse length is bounded by the flash time-out.

  led:
    type: object
    $ref: common.yaml#
    description: Properties for the LED.
    properties:
      function: true
      color: true

      flash-max-timeout-us:
        description: Flash LED maximum timeout. The hardware supports
          40ms to 1600ms.

      led-max-microamp:
        maximum: 376000
        description: Maximum torch mode current.

      flash-max-microamp:
        maximum: 1500000
        description: Maximum flash mode current.

    additionalProperties: false

required:
  - compatible
  - reg
  - led

additionalProperties: false

examples:
  - |
    #include <dt-bindings/gpio/gpio.h>
    #include <dt-bindings/leds/common.h>

    i2c {
      #address-cells = <1>;
      #size-cells = <0>;

      flash@64 {
        compatible = "kinetic,ktd2691";
        reg = <0x64>;

        led {
          function = LED_FUNCTION_FLASH;
          color = <LED_COLOR_ID_WHITE>;
          flash-max-timeout-us = <1000000>;
          flash-max-microamp = <1500000>;
          led-max-microamp = <376000>;
        };
      };
    };

...
```

## Documentation/devicetree/bindings/media/i2c/samsung,s5k3l6.yaml
```yaml
# SPDX-License-Identifier: (GPL-2.0-only OR BSD-2-Clause)
%YAML 1.2
---
$id: http://devicetree.org/schemas/media/i2c/samsung,s5k3l6.yaml#
$schema: http://devicetree.org/meta-schemas/core.yaml#

title: Samsung S5K3L6 13MP MIPI CSI-2 image sensor

maintainers:
  - Vincent Cloutier <vincent@cloutier.co>
  - Purism Kernel Team <kernel@puri.sm>
  - Onur BÜBER <onurbuber@engineer.com>

description: |-
  The Samsung S5K3L6 is a raw Bayer image sensor with a MIPI CSI-2 image
  data interface and an I2C-compatible control bus.

allOf:
  - $ref: /schemas/media/video-interface-devices.yaml#

properties:
  compatible:
    const: samsung,s5k3l6

  reg:
    maxItems: 1

  clocks:
    description: Reference to the sensor input clock.
    maxItems: 1

  reset-gpios:
    description: Active-low reset GPIO.
    maxItems: 1

  vdda-supply:
    description: Analog power supply.

  vddd-supply:
    description: Digital core power supply.

  vddio-supply:
    description: Digital I/O power supply.

  port:
    $ref: /schemas/graph.yaml#/$defs/port-base
    unevaluatedProperties: false

    properties:
      endpoint:
        $ref: /schemas/media/video-interfaces.yaml#
        unevaluatedProperties: false

        properties:
          data-lanes:
            items:
              - const: 1
              - const: 2

          link-frequencies:
            items:
              - const: 537500000
              - const: 600000000
              - const: 625000000

        required:
          - data-lanes
          - link-frequencies

required:
  - compatible
  - reg
  - clocks
  - vdda-supply
  - vddd-supply
  - vddio-supply
  - port

unevaluatedProperties: false

examples:
  - |
    #include <dt-bindings/gpio/gpio.h>

    /*
     * The master clock is board specific: the sensor accepts 19.2, 24 and
     * 25 MHz and derives its PLL settings from whichever is supplied.
     */
    clk_19m2: clock {
        compatible = "fixed-clock";
        #clock-cells = <0>;
        clock-frequency = <19200000>;
    };

    reg_vdda: regulator-vdda {
        compatible = "regulator-fixed";
        regulator-name = "vdda";
        regulator-min-microvolt = <2800000>;
        regulator-max-microvolt = <2800000>;
    };

    reg_vddd: regulator-vddd {
        compatible = "regulator-fixed";
        regulator-name = "vddd";
        regulator-min-microvolt = <1200000>;
        regulator-max-microvolt = <1200000>;
    };

    reg_vddio: regulator-vddio {
        compatible = "regulator-fixed";
        regulator-name = "vddio";
        regulator-min-microvolt = <1800000>;
        regulator-max-microvolt = <1800000>;
    };

    i2c {
        #address-cells = <1>;
        #size-cells = <0>;

        camera@10 {
            compatible = "samsung,s5k3l6";
            reg = <0x10>;

            clocks = <&clk_19m2>;

            reset-gpios = <&tlmm 24 GPIO_ACTIVE_LOW>;
            vdda-supply = <&reg_vdda>;
            vddd-supply = <&reg_vddd>;
            vddio-supply = <&reg_vddio>;

            orientation = <1>;
            rotation = <90>;

            port {
                camera_out: endpoint {
                    data-lanes = <1 2>;
                    link-frequencies = /bits/ 64
                        <537500000 600000000 625000000>;
                    remote-endpoint = <&mipi_csi2_in>;
                };
            };
        };
    };
...
```

## Documentation/devicetree/bindings/regulator/willsemi,wl2866d.yaml
```yaml
# SPDX-License-Identifier: (GPL-2.0-only OR BSD-2-Clause)
%YAML 1.2
---
$id: http://devicetree.org/schemas/regulator/willsemi,wl2866d.yaml#
$schema: http://devicetree.org/meta-schemas/core.yaml#

title: Willsemi WL2866D camera PMIC regulators

maintainers:
  - Onur BÜBER <onurbuber@engineer.com>

description: |
  The WL2866D is a four channel LDO PMIC used to power camera sensors and
  their I/O rails. It has two DVDD outputs covering 600-1500 mV in 6 mV
  steps and two AVDD outputs covering 1200-3000 mV in 12.5 mV steps. Each
  output is switched by a bit in the enable register, and a chip-wide
  discharge register can bleed the rails when they are turned off.

  The chip only responds on I2C once its EN pin is asserted, so boards that
  gate the supply with a GPIO have to describe it.

  Downstream Qualcomm trees describe the same part as "ovti,wl2866d" and
  "ovti,wl2866d-i2c"; those compatible strings are not used here.

properties:
  compatible:
    const: willsemi,wl2866d

  reg:
    maxItems: 1

  enable-gpios:
    description: GPIO connected to the EN pin, active high.
    maxItems: 1

  regulators:
    type: object
    additionalProperties: false

    patternProperties:
      "^(dvdd|avdd)[12]$":
        type: object
        $ref: regulator.yaml#
        unevaluatedProperties: false

required:
  - compatible
  - reg
  - regulators

additionalProperties: false

examples:
  - |
    #include <dt-bindings/gpio/gpio.h>

    i2c {
        #address-cells = <1>;
        #size-cells = <0>;

        pmic@28 {
            compatible = "willsemi,wl2866d";
            reg = <0x28>;
            enable-gpios = <&tlmm 26 GPIO_ACTIVE_HIGH>;

            regulators {
                dvdd1: dvdd1 {
                    regulator-name = "dvdd1";
                    regulator-min-microvolt = <1200000>;
                    regulator-max-microvolt = <1200000>;
                };

                dvdd2: dvdd2 {
                    regulator-name = "dvdd2";
                    regulator-min-microvolt = <1050000>;
                    regulator-max-microvolt = <1050000>;
                };

                avdd1: avdd1 {
                    regulator-name = "avdd1";
                    regulator-min-microvolt = <2800000>;
                    regulator-max-microvolt = <2800000>;
                };

                avdd2: avdd2 {
                    regulator-name = "avdd2";
                    regulator-min-microvolt = <2800000>;
                    regulator-max-microvolt = <2800000>;
                };
            };
        };
    };
```
